## base_external/package/ldd/Config.in
```kconfig
config BR2_PACKAGE_LDD
	bool "ldd"
	help
	  Includes some kermel modules from the LDD
	  Used to understand buildroot external trees and package builds.
```
